## base_external/package/aesdchar/Config.in
```kconfig
config BR2_PACKAGE_AESDCHAR
	bool "aesdchar"
	help
	   This package builds aesd_char sub directories.
	   This package installs the aesdchar kernel module from aesd_char directory.
```

## base_external/package/ldd/Config.in
```kconfig
config BR2_PACKAGE_LDD
    bool "LDD Kernel Modules"
    help
      This package installs the LDD kernel modules (misc-modules and scull).
```
